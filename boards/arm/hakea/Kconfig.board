## boards/arm/hakea/Kconfig.board
```kconfig
config BOARD_HAKEA_LEFT
    bool "hakea left"
    depends on SOC_NRF52840_QIAA

config BOARD_HAKEA_RIGHT
    bool "hakea right"
    depends on SOC_NRF52840_QIAA
```

## boards/shields/dangle/Kconfig.shield
```kconfig
# No whitespace after the comma or in the keyboard name!
config SHIELD_DANGLE
    def_bool $(shields_list_contains,dangle)
```

## boards/shields/dingle/Kconfig.defconfig
```kconfig
# Copyright (c) 2019 Jan Van Winkel <jan.van_winkel@dxplore.eu>
# SPDX-License-Identifier: Apache-2.0

if SHIELD_ST7789V_RAW_240X240

# Max 16 characters in keyboard name
config ZMK_KEYBOARD_NAME
    default "Hakea"

config ZMK_SPLIT_ROLE_CENTRAL
    default y

config ZMK_SPLIT
    default y

# Set this to the number of peripherals your dongle will have.
# For a unibody, this would be 1. If you have left and right halves, set it to 2, etc.
config ZMK_SPLIT_BLE_CENTRAL_PERIPHERALS
    default 2

# Set this to ZMK_SPLIT_BLE_CENTRAL_PERIPHERALS + your desired number of BT profiles (default is 5)
config BT_MAX_CONN
    default 6

# Set this to the same number as BT_MAX_CONN
config BT_MAX_PAIRED
    default 6

if DISPLAY

choice ST7789V_PIXEL_FORMAT
	default ST7789V_RGB888 if SHIELD_ST7789V_TL019FQV01
	default ST7789V_RGB565 if SHIELD_ST7789V_WAVESHARE_240X240 || SHIELD_ST7789V_RAW_240X240
endchoice

if LVGL

config LV_Z_BITS_PER_PIXEL
	default 24 if SHIELD_ST7789V_TL019FQV01
	default 16 if SHIELD_ST7789V_WAVESHARE_240X240 || SHIELD_ST7789V_RAW_240X240

choice LV_COLOR_DEPTH
	default LV_COLOR_DEPTH_16 if SHIELD_ST7789V_WAVESHARE_240X240 || SHIELD_ST7789V_RAW_240X240
endchoice

configdefault LV_COLOR_16_SWAP
	default y if SHIELD_ST7789V_WAVESHARE_240X240
	default y if SHIELD_ST7789V_RAW_240X240 || SHIELD_ST7789V_RAW_240X240

endif # LVGL

endif # DISPLAY

config PWM
    default y


endif # SHIELD_ST7789V_TL019FQV01 || SHIELD_ST7789V_WAVESHARE_240X240 || SHIELD_ST7789V_RAW_240X240
```

## boards/shields/dingle/Kconfig.shield
```kconfig
# No whitespace after the comma or in the keyboard name!
config SHIELD_DINGLE
    def_bool $(shields_list_contains,dingle)
```

## boards/shields/hakea-esp/Kconfig.shield
```kconfig
# No whitespace after the comma or in the keyboard name!
config SHIELD_HAKEA_ESP_DONGLE
    def_bool $(shields_list_contains,hakea_esp_dongle)
```

## boards/shields/hakea-prospector/Kconfig.shield
```kconfig
# No whitespace after the comma or in the keyboard name!
config SHIELD_HAKEA_PROSPECTOR
    def_bool $(shields_list_contains,hakea_prospector)
```

## boards/shields/hakea/Kconfig.shield
```kconfig
# No whitespace after the comma or in the keyboard name!
config SHIELD_HAKEA_DONGLE
    def_bool $(shields_list_contains,hakea_dongle)
```

## boards/shields/scylla-left/Kconfig.shield
```kconfig
# No whitespace after the comma or in the keyboard name!
config SHIELD_SCYLLA_LEFT_DONGLE
    def_bool $(shields_list_contains,scylla_left_dongle)
```

## boards/shields/scylla-right/Kconfig.shield
```kconfig
# No whitespace after the comma or in the keyboard name!
config SHIELD_SCYLLA_RIGHT_DONGLE
    def_bool $(shields_list_contains,scylla_right_dongle)
```

## boards/tokas/hakea/Kconfig.hakea
```kconfig
config BOARD_HAKEA_LEFT
    SELECT SOC_NRF52840_QIAA

config BOARD_HAKEA_RIGHT
    SELECT SOC_NRF52840_QIAA
```

## boards/tokas/hakea/board.yml
```yaml
boards:
  - name: hakea_left
    vendor: tokas
    revision:
      format: major.minor.patch
      default: 1.0.0
      exact: true
      revisions:
        - name: 1.0.0
    socs:
      - name: nrf52840
```
