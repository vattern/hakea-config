// This file was generated from a template. Edit it to match your keyboard.
// See https://zmk.dev/docs/development/hardware-integration/new-shield for more
// instructions.

#include "hakea.dtsi"
#include "hakea_left-pinctrl.dtsi"

&kscan {
    // Replace these comments with the GPIO pins in the matrix for the left side.
    // See https://zmk.dev/docs/development/hardware-integration/new-shield#shield-overlays
    col-gpios
                = <&gpio0 23  GPIO_ACTIVE_HIGH>
                , <&gpio1 2   GPIO_ACTIVE_HIGH>
                , <&gpio0 9   GPIO_ACTIVE_HIGH>
                , <&gpio1 6   GPIO_ACTIVE_HIGH>
                , <&gpio1 4   GPIO_ACTIVE_HIGH>
                , <&gpio0 10  GPIO_ACTIVE_HIGH>
                ;
};

&left_encoder {
        status = "okay";
    };
