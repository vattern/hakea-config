// This file was generated from a template. Edit it to match your keyboard.
// See https://zmk.dev/docs/development/hardware-integration/new-shield for more
// instructions.

#include "hakea.dtsi"
#include "hakea_right-pinctrl.dtsi"

&default_transform {
    // Set this to the number of columns on the left side.
    col-offset = <6>;
};

&kscan {
    // Replace these comments with the GPIO pins in the matrix for the right side.
    // See https://zmk.dev/docs/development/hardware-integration/new-shield#shield-overlays
    col-gpios
                = <&gpio0 10  GPIO_ACTIVE_HIGH>
                , <&gpio1 4   GPIO_ACTIVE_HIGH>
                , <&gpio1 6   GPIO_ACTIVE_HIGH>
                , <&gpio0 9   GPIO_ACTIVE_HIGH>
                , <&gpio1 2   GPIO_ACTIVE_HIGH>
                , <&gpio0 23  GPIO_ACTIVE_HIGH>
                ;
};

&right_encoder {
    status = "okay";
};